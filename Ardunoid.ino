/*************************************************************/
/* Class: Ardunoid                                           */
/* Version: 1.0                                              */
/* Programmer: Matthew Schalk / Michael Macdonald            */
/* Level Design Help: ReGroove23 (nintendoage.com)           */
/*                    Antoine Fantys (FG Soft)               */
/* Date Created: 23 August 2018                              */
/* Last Modified: 12 September 2018                          */
/*************************************************************/

#include <Wire.h>
#include <EEPROM.h>
#include <Adafruit_GFX.h>
#include <Adafruit_SSD1306.h>


#define OLED_RESET 4
Adafruit_SSD1306 display(OLED_RESET);

//button inputs
const uint8_t upPin = 3;//the up button
const uint8_t downPin = 4;//the down button
const uint8_t leftPin = 5;//the left button
const uint8_t rightPin = 6;//the right button
const uint8_t aPin = 7;//the action button

#define WALL_TOP 16
#define LEVEL_GEN_START_X 64

uint8_t PADDLE_SIZE = 8;//the size of the paddle, decrease for higher difficulty
uint8_t level = 1;//which level you are currently on
int8_t lives = 2;//the amount of lives you currently have
long score = 0;//the users score
int lifeScore = 0;
int oneupCounter = -1;
int numberOfBlocks = 0;//the number of blocks remaining

//attract mode stuff
boolean attract = false;
int attractCounter = 0;
uint8_t cheatCounter = 0;

//positions
uint8_t paddlePosition = 35;//the current position on the top of the paddle
uint8_t ballPositionX = 1;
uint8_t ballPositionY = 38;
uint8_t ballFrontMiddleX = 4;
uint8_t ballFrontMiddleY = 39;

//0 is down & right
//1 is up & right
//2 is down & left
//3 is up & left
uint8_t ballDirection = 0;

uint8_t died = 0;//if the player died

//all of the levels except level1 (the test level)
#define NUMBER_OF_LEVELS 50//The max number of levels
uint8_t blockGrid [21][9];//the grid that generates the level

const uint8_t level2 [] PROGMEM = {0,1,0,0,0,1,0,0,0,1,0,0,0,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0,0};
const uint8_t level3 [] PROGMEM = {0,0,0,0,0,0,0,0,0,0,0,0,0,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0,0};
const uint8_t level4 [] PROGMEM = {0,0,0,0,0,0,0,1,1,0,0,0,0,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0,0};
const uint8_t level5 [] PROGMEM = {0,0,0,0,0,0,0,0,1,1,1,1,1,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0,0};
const uint8_t level6 [] PROGMEM = {0,0,0,0,0,0,1,0,0,0,0,0,1,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0,0};
const uint8_t level7 [] PROGMEM = {0,0,0,0,0,0,0,0,0,0,0,0,0,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0,0};
const uint8_t level8 [] PROGMEM = {0,0,0,0,0,0,0,0,1,1,0,0,0,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0,0};
const uint8_t level9 [] PROGMEM = {1,1,1,1,1,1,1,1,1,1,1,1,1,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1,1};
const uint8_t level10 [] PROGMEM = {1,0,1,0,1,1,0,1,0,1,1,0,0,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1,0};
const uint8_t level11 [] PROGMEM = {0,0,1,1,1,1,1,0,0,0,1,1,1,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1,0};
const uint8_t level12 [] PROGMEM = {1,1,1,1,1,1,1,1,1,1,1,1,1,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1,1};
const uint8_t level13 [] PROGMEM = {0,1,0,1,0,1,0,0,0,0,1,0,1,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0,0};
const uint8_t level14 [] PROGMEM = {0,1,1,1,1,1,1,1,1,1,1,1,1,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1,0};
const uint8_t level15 [] PROGMEM = {0,0,0,0,0,0,0,1,1,1,1,1,1,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0,1};
const uint8_t level16 [] PROGMEM = {1,1,0,0,0,0,0,1,1,1,1,1,1,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1,1};
const uint8_t level17 [] PROGMEM = {1,1,1,1,0,0,0,0,0,0,0,0,0,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1,1};
const uint8_t level18 [] PROGMEM = {1,1,1,1,1,1,1,1,1,1,1,1,1,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1,1};
const uint8_t level19 [] PROGMEM = {1,1,1,1,1,1,1,1,1,1,1,1,1,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1,1};
const uint8_t level20 [] PROGMEM = {1,1,1,1,1,1,1,1,1,1,1,1,1,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1,1};
const uint8_t level21 [] PROGMEM = {0,0,0,0,1,1,1,1,1,1,1,1,1,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0,0};
const uint8_t level22 [] PROGMEM = {0,0,0,0,0,0,0,0,0,0,0,0,0,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0,0};
const uint8_t level23 [] PROGMEM = {1,0,0,0,0,0,0,0,0,1,0,1,0,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0,1};
const uint8_t level24 [] PROGMEM = {0,0,0,0,0,0,0,0,0,0,0,0,0,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0,0};
const uint8_t level25 [] PROGMEM = {0,0,0,0,0,0,0,0,0,0,0,0,0,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0,0};
const uint8_t level26 [] PROGMEM = {0,0,1,1,1,1,1,0,0,0,0,0,0,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0,0};
const uint8_t level27 [] PROGMEM = {0,0,1,1,1,1,1,0,0,0,0,0,0,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0,0};
const uint8_t level28 [] PROGMEM = {0,0,1,1,1,1,1,0,0,0,0,0,0,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0,1};
const uint8_t level29 [] PROGMEM = {0,0,0,0,0,0,0,0,0,0,0,0,0,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1,1};
const uint8_t level30 [] PROGMEM = {0,0,0,0,0,0,0,0,0,0,0,0,0,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1,1};
const uint8_t level31 [] PROGMEM = {0,0,0,0,0,0,0,0,0,0,0,0,0,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0,0};
const uint8_t level32 [] PROGMEM = {0,0,0,0,0,0,0,0,0,0,0,0,0,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1,0};
const uint8_t level33 [] PROGMEM = {0,0,0,0,1,1,1,1,0,0,0,0,0,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0,0};
const uint8_t level34 [] PROGMEM = {0,0,0,0,0,1,1,0,1,1,1,1,1,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0,0};
const uint8_t level35 [] PROGMEM = {0,0,0,0,0,0,0,0,0,0,0,0,0,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0,0};
const uint8_t level36 [] PROGMEM = {0,0,0,0,0,0,0,0,1,0,0,0,0,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0,0};
const uint8_t level37 [] PROGMEM = {0,1,1,1,1,1,1,1,1,1,1,1,1,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0,0};
const uint8_t level38 [] PROGMEM = {1,1,0,0,0,0,0,1,1,0,0,0,0,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0,0};
const uint8_t level39 [] PROGMEM = {1,1,1,0,0,1,1,1,0,0,1,1,1,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0,1};
const uint8_t level40 [] PROGMEM = {1,1,1,1,1,1,0,1,1,0,0,0,1,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1,0};
const uint8_t level41 [] PROGMEM = {0,0,0,0,1,1,0,0,0,0,0,0,0,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0,0};
const uint8_t level42 [] PROGMEM = {0,0,0,1,1,1,0,0,0,1,1,1,0,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0,0};
const uint8_t level43 [] PROGMEM = {0,0,0,0,0,0,0,1,1,0,0,0,0,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0,0};
const uint8_t level44 [] PROGMEM = {1,0,0,0,0,0,0,1,1,1,0,0,0,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1,0};
const uint8_t level45 [] PROGMEM = {1,1,1,0,0,0,0,0,0,0,0,0,0,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0,0};
const uint8_t level46 [] PROGMEM = {0,0,0,0,0,1,0,0,0,0,0,0,0,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0,0};
const uint8_t level47 [] PROGMEM = {0,0,0,0,0,0,0,0,1,1,1,1,1,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0,0};
const uint8_t level48 [] PROGMEM = {0,0,0,0,0,0,0,0,0,0,0,0,0,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0,0};
const uint8_t level49 [] PROGMEM = {0,0,0,0,0,0,0,1,1,1,1,1,1,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0,0};
const uint8_t level50 [] PROGMEM = {0,1,0,0,0,1,0,0,0,1,0,0,0,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1,1};

/**************************************************************************/
/* Method: setup                                                          */
/* Purpose: stuff to run before the loop is setup                         */
/* Inputs: None                                                           */
/* Returns: Nothing                                                       */
/**************************************************************************/
void setup()   
{                
  //initiate the display
  display.begin(SSD1306_SWITCHCAPVCC, 0x3C);//I2C address is 0x3C

  //Serial.begin(9600);//used for debugging, eats up a lot of memory!
  
  //set the buttons...
  pinMode(upPin, INPUT);
  pinMode(downPin, INPUT);
  pinMode(leftPin, INPUT);
  pinMode(rightPin, INPUT);
  pinMode(aPin, INPUT);//probably used for pause button and start button
  display.clearDisplay();//we don't want the adafruit logo

  if(digitalRead(aPin) == HIGH && digitalRead(upPin) == HIGH)
  {
    EEPROM.write(2, 'M');
    EEPROM.write(4, 'S');
    EEPROM.write(6, 'S');
    EEPROM.write(8, 0);
    EEPROM.write(9,0);
    EEPROM.write(10,0);
    EEPROM.write(11,1);
    EEPROM.write(12,0);
    EEPROM.write(13,0);
    
  
    display.setCursor(0,0);
    display.setTextSize(1);
    display.setTextColor(WHITE);
    display.print(F("High score was reset!"));
    display.display();
    delay(3000);
    while(digitalRead(aPin) == HIGH){};
    display.clearDisplay();
  }
}

/**************************************************************************/
/* Method: loop                                                           */
/* Purpose: the main hardware loop. Will go as long as there is a clock   */
/* Inputs: None                                                           */
/* Returns: Nothing                                                       */
/**************************************************************************/
void loop()
{
  resetGame();
  display.clearDisplay();
  titleScreen();
  display.display();
  attract = true;
  attractCounter = 0;//reset this, otherwise there will be issues after game over
  setupInterrupt(1);
  enableInterrupt();
  int code = cheatCodeDetection();
  attract = false;
  disableInterrupt();
  while(digitalRead(aPin) == HIGH){};//wait until the user releases
  resetGame();//needs to be here because of attract mode
  display.clearDisplay();

  if(code)//if they know the code then lets go to the level select
    levelSelect();
    
  
  loadBoard(level);
  updatePaddle();
  updateScoreBoard(level, lives, score);
  drawBall();
  display.display();
  readyGo();
  setupInterrupt(20);//15 minimum 30 is the max
  enableInterrupt();
  while(1)//run this forever
  {
    if(digitalRead(upPin) == HIGH)
      movePaddle(0);
    else if(digitalRead(downPin) == HIGH)
      movePaddle(1);
    
    if(digitalRead(aPin) == HIGH)//if a button is pressed, pause the game
      pause();
    
    updateScoreBoard(level, lives, score);   
    
    if(lives >= 0)
      display.display();
      
    if(died == 1)//if the user loses a life
    {
      disableInterrupt();
      died = 0;
      resetBoard();
      ouch();
      lives--;
      if(lives >= 0)
      {
        readyGo();
        enableInterrupt();
      }
      else
      {
        disableInterrupt();
        gameOver();
        break;
      }
    }
    if(numberOfBlocks == 0)//if we clear the level
    {
      disableInterrupt();
      level++;
      loadBoard(level);
      score += 100;
      lifeScore += 100;
      resetBoard();
      readyGo();
      enableInterrupt();
    }

    if(lifeScore >= 500)//reward the player with an extra life
    {
      if(lives < 100)
      {
        lives++;
        display.setTextSize(1);
        display.setTextColor(WHITE);
        display.setCursor(80,8);
        display.print(F("1-UP!"));
        oneupCounter = 60;
      }
      lifeScore = 0;
    }

    if(oneupCounter == 0);
      updateScoreBoard(level,lives,score);
  }
}

/**************************************************************************/
/* Method: highScore                                                      */
/* Purpose: checks and writes the highscore to eeprom                     */
/* Inputs: None                                                           */
/* Returns: Nothing                                                       */
/**************************************************************************/
void highScore()
{
  int hs = 0; 

  //read the eeprom to check score
  hs+= EEPROM.read(13);
  hs+= EEPROM.read(12)*10;
  hs+= EEPROM.read(11)*100;
  hs+= EEPROM.read(10)*1000;
  hs+= EEPROM.read(9)*10000;
  hs+= EEPROM.read(8)*100000;
  
  if(hs >= score)
    return;//dont bother with the highscore stuff...
  
  display.clearDisplay();//erase the screen
  display.setCursor(24,0);
  display.println(F("New High Score!"));
  display.setCursor(6,16);
  display.println(F("Enter your initials!"));
  display.setCursor(5,56);
  display.println(F("Press 'A' to confirm"));
  int charIndex = 0;//2 is max
  char init1 = 'A';
  char init2 = 'A';
  char init3 = 'A';
  
  display.setCursor(26,35);
  display.print(init1);
  display.print(F("     "));
  display.print(init2);
  display.print(F("     "));
  display.print(init3);
  display.setCursor(26,38);
  display.print(F("_"));
  display.display();

  boolean changed = false;
  
  while(digitalRead(aPin) != HIGH)
  {
    display.setCursor(26,35);
    display.print(init1);
    display.print(F("     "));
    display.print(init2);
    display.print(F("     "));
    display.print(init3);
    display.setCursor(26,38);

    if(charIndex == 0)
      display.print(F("_"));
    else if(charIndex == 1)
      display.print(F("      _"));
    else
      display.print(F("            _"));

    if(changed)
      display.display();
    changed = false;
    
    if(charIndex == 0)
    {
       if(digitalRead(upPin) == HIGH && digitalRead(downPin) == LOW)
       {
        init1--;
        if(init1 < 'A')
          init1 = 'Z';
        changed = true;
       }
       else if(digitalRead(downPin) == HIGH && digitalRead(upPin) == LOW)
       {
        init1++;
        if(init1 > 'Z')
          init1 = 'A';
        changed = true;
       }
  
       while(digitalRead(downPin) == HIGH || digitalRead(upPin) == HIGH){};//wait for release
       delay(25);
    }
    else if(charIndex == 1)
    {
       if(digitalRead(upPin) == HIGH && digitalRead(downPin) == LOW)
       {
        init2--;
        if(init2 < 'A')
          init2 = 'Z';
        changed = true;
       }
       else if(digitalRead(downPin) == HIGH && digitalRead(upPin) == LOW)
       {
        init2++;
        if(init2 > 'Z')
          init2 = 'A';
        changed = true;
       }
       
      while(digitalRead(downPin) == HIGH || digitalRead(upPin) == HIGH){};//wait for release
      delay(25);
    }
    else//index = 3
    {
       if(digitalRead(upPin) == HIGH && digitalRead(downPin) == LOW)
       {
        init3--;
        if(init3 < 'A')
          init3 = 'Z';
        changed = true;
       }
       else if(digitalRead(downPin) == HIGH && digitalRead(upPin) == LOW)
       {
        init3++;
        if(init3 > 'Z')
          init3 = 'A';
        changed = true;
       }
      while(digitalRead(downPin) == HIGH || digitalRead(upPin) == HIGH){};//wait for release
      delay(25);
    }
  
    if(digitalRead(leftPin) == HIGH && digitalRead(rightPin) == LOW)
    {
      charIndex--;
      if(charIndex < 0)
        charIndex = 2;
      while(digitalRead(leftPin) == HIGH){};
      changed = true;
    }
    if(digitalRead(leftPin) == LOW && digitalRead(rightPin) == HIGH)
    {
      charIndex++;
      if(charIndex > 2)
        charIndex = 0;
      while(digitalRead(rightPin) == HIGH){};
      changed = true;
    }
    for(int i = 25; i < 50; i++)
      display.drawLine(0, i, display.width()-1,i, BLACK);//clear the current paddle
  }
  
  //write the initials and the score
  EEPROM.write(2, init1);
  EEPROM.write(4, init2);
  EEPROM.write(6, init3);
  EEPROM.write(8, (score/100000) %10);
  EEPROM.write(9, (score/10000) %10);
  EEPROM.write(10,(score/1000) %10);
  EEPROM.write(11,(score/100) %10);
  EEPROM.write(12,(score/10) %10);
  EEPROM.write(13,score % 10);
  
  while(digitalRead(aPin) == HIGH){};//wait for release
  delay(25);//debounce
}

/**************************************************************************/
/* Method: cheatCodeDetection                                             */
/* Purpose: checks if the user inputs the cheat code                      */
/* Inputs: None                                                           */
/* Returns: detect: int - whether or not the cheat code was entered right */
/**************************************************************************/
int cheatCodeDetection()//either return 0 or 1. 0 being incorrect and A, 1 being correct
{
  //up down up down left right left right a
  int correctCounter = 0;
  int buttonCounter = 0;
  while(digitalRead(aPin) != HIGH)
  {
    //if((attractCounter % 10) == 0)
      display.display();
    
    if(digitalRead(upPin) == HIGH)
      buttonCounter++;
    if(digitalRead(downPin) == HIGH)
      buttonCounter++;
    if(digitalRead(leftPin) == HIGH)
      buttonCounter++;
    if(digitalRead(rightPin) == HIGH)
      buttonCounter++;

    if(buttonCounter > 1)//one button at a time
    {
      if(correctCounter == 0 || correctCounter == 1)
      {
        if(digitalRead(upPin) == HIGH)
        {
          correctCounter++;
          while(digitalRead(upPin) == HIGH){};//wait for the user to release
          delay(25);
        }
        else if(digitalRead(downPin) == HIGH || (digitalRead(rightPin) == HIGH || digitalRead(leftPin) == HIGH))
          correctCounter = 0;
      }

      if(correctCounter == 2 || correctCounter == 3)
      {
        if(digitalRead(downPin) == HIGH)
        {
          correctCounter++;
          while(digitalRead(downPin) == HIGH){};//wait for the user to release
          delay(25);
        }
        else if(digitalRead(upPin) == HIGH || (digitalRead(rightPin) == HIGH || digitalRead(leftPin) == HIGH))
          correctCounter = 0; 
      }

      if(correctCounter == 4 || correctCounter == 6)
      {
        if(digitalRead(leftPin) == HIGH)
        {
          correctCounter++;
          while(digitalRead(leftPin) == HIGH){};//wait for the user to release
          delay(25);
        }
        else if(digitalRead(upPin) == HIGH || (digitalRead(rightPin) == HIGH || digitalRead(downPin) == HIGH))
          correctCounter = 0; 
      }

      if(correctCounter == 5 || correctCounter == 7)
      {
        if(digitalRead(rightPin) == HIGH)
        {
          correctCounter++;
          while(digitalRead(rightPin) == HIGH){};//wait for the user to release
          delay(25);
        }
        else if(digitalRead(upPin) == HIGH || (digitalRead(leftPin) == HIGH || digitalRead(downPin) == HIGH))
          correctCounter = 0; 
      }
    }
    else
      correctCounter == 0;
  }
  
  if(correctCounter == 8)
    return 1;
  else 
    return 0;
}
